

; Replace with your application code
START:
	LDI R16,0X00	;LOAD ZEROS INTO R16 FOR DDRD		
	LDI R17,0X00	;LOAD ZEROS INTO R17 FOR DDRB
	LDI R18,0X00	; LOAD 1 INTO DDRC FOR DDRC
	LDI R19,0X00	;TEMP REGISTER

	OUT DDRD,R16
	OUT DDRB,R16
	OUT DDRC,R18
						  ;SWITCH THESE PORTC BIT 6IS ALWAYS ON 
	IN R19,PINB			;INSERT VALUES OF PINSB INTO REGISTER R19 AND CHECK WHICH BIT IS CLEAR IF TRUE SKIP BRANCHING
	SBRC R19,0
	RJMP ADDITION
	SBRC R19,1
	RJMP SUBTRACTION
	SBRC R19,2
	RJMP MULTIPLICATION
	SBRC R19,3
	RJMP ANDING
	SBRC R19,4
	RJMP ORING
	SBRC R19,5
	RJMP XORING

	JMP START

ADDITION:
		LDI R20,0X44	;LOAD VALUS TO OPERATE ON
		LDI R21,0X66	;
		ADD R21,R20
		OUT PORTD,R21
		SBI PORTC,1
		CALL DELAY
		CALL DELAY
		CALL DELAY
		NOP
		NOP
		CALL DELAY
		OUT PORTD,R17
		CBI PORTC,1
		JMP START

SUBTRACTION :
		LDI R20,0X44	;LOAD VALUS TO OPERATE ON
		LDI R21,0X66	;
		SUB R21,R20
		OUT PORTD,R21
		SBI PORTC,2
		CALL DELAY
		CALL DELAY
		CALL DELAY
		NOP
		NOP
		CALL DELAY
		OUT PORTD,R17
		CBI PORTC,2
		JMP START

MULTIPLICATION :
		SBI PORTC,3
		CALL DELAY
		CALL DELAY
		NOP
		NOP
		CBI PORTC,3
		LDI R20,0X44	;LOAD VALUS TO OPERATE ON
		LDI R21,0X66
		MUL R21,R20	
		MOV R10,R0		;need to perform a move instruction due to the result exceeding the register capacity.
		MOV R11,R1				;dividing result into registers lowbyte and highbyte.will display the result complete result on portc
		OUT PORTD,R10
		OUT PORTC,R11
		
		CALL DELAY
		CALL DELAY
		CALL DELAY
		NOP
		NOP
		CALL DELAY
		OUT PORTD,R17
		OUT PORTC,R17
		
		JMP START

ANDING :
		LDI R20,0X44	;LOAD VALUS TO OPERATE ON
		LDI R21,0X66	;
		AND R21,R20
		OUT PORTD,R21
		SBI PORTC,4
		CALL DELAY
		CALL DELAY
		CALL DELAY
		NOP
		NOP
		CALL DELAY
		OUT PORTD,R17	;SET ZEROS AGAIN TO CLEAR LEDS
		CBI PORTC,4
		JMP START
ORING :
		LDI R20,0X44	;LOAD VALUS TO OPERATE ON
		LDI R21,0X66	;
		OR R21,R20
		OUT PORTD,R21
		SBI PORTC,5
		CALL DELAY
		CALL DELAY
		CALL DELAY
		NOP
		NOP
		CALL DELAY
		OUT PORTD,R17
		CBI PORTC,5
		JMP START

XORING :
		LDI R20,0X44	;LOAD VALUS TO OPERATE ON
		LDI R21,0X66	;
		EOR R21,R20
		OUT PORTD,R21
		SBI PORTC,0
		CALL DELAY
		CALL DELAY
		CALL DELAY
		NOP
		NOP
		CALL DELAY
		OUT PORTD,R17
		CBI PORTC,0
		JMP START

DELAY:
	LDI R23,255
	LOOP1: LDI R24,255
	LOOP2: DEC R24
			BRNE LOOP2
			NOP
			NOP
			NOP
			DEC R23
			BRNE LOOP1
			RET


